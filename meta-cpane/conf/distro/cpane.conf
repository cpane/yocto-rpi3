## meta-cpane/conf/distro/cpane.conf
```bitbake
# Custom distro based on poky
require conf/distro/poky.conf

DISTRO = "cpane"
DISTRO_NAME = "cpane"
DISTRO_VERSION = "1.0"

# Systemd configuration
DISTRO_FEATURES:append = " systemd usrmerge wifi ethernet"
VIRTUAL-RUNTIME_init_manager = "systemd"
VIRTUAL-RUNTIME_initscripts = "systemd-compat-units"
DISTRO_FEATURES_BACKFILL_CONSIDERED += "sysvinit"
SYSTEMD_DEFAULT_TARGET = "multi-user.target"

# Allow restricted firmware
LICENSE_FLAGS_ACCEPTED:append = " synaptics-killswitch"

# Image format
IMAGE_FSTYPES:append = " rpi-sdimg"

# Serial console configuration
# Use the primary UART on GPIO pins 14/15 by disabling Bluetooth
ENABLE_UART = "1"
SERIAL_CONSOLES = "115200;ttyAMA0"
RPI_KERNEL_DEVICETREE_OVERLAY:append = " disable-bt"

# Additional UART configuration
RPI_EXTRA_CONFIG:append = '\n# Enable UART\nenable_uart=1\n'

# Common image packages
IMAGE_INSTALL:append = " \
    dhcpcd \
    avahi-daemon \
    avahi-utils \
    connman \
    connman-client \
    ethtool \
    iptables \
    openssh \
    nano \
    htop \
    wget \
    curl \
    rsync \
    cpane-users \
    serial-setup \
    minicom \
    screen \
    util-linux \
"

# Avoid postinstall hwdb failures
BAD_RECOMMENDATIONS:append = " udev-hwdb"
```

## meta-cpane/conf/layer.conf
```bitbake
# We have a conf and classes directory, add to BBPATH
BBPATH .= ":${LAYERDIR}"

# We have recipes-* directories, add to BBFILES
BBFILES += "${LAYERDIR}/recipes-*/*/*.bb \
            ${LAYERDIR}/recipes-*/*/*.bbappend \
            ${LAYERDIR}/recipes-*/*.bb \
            ${LAYERDIR}/recipes-*/*.bbappend"



BBFILE_COLLECTIONS += "meta-cpane"
BBFILE_PATTERN_meta-cpane = "^${LAYERDIR}/"
BBFILE_PRIORITY_meta-cpane = "6"

LAYERDEPENDS_meta-cpane = "core"
LAYERSERIES_COMPAT_meta-cpane = "scarthgap"
```
